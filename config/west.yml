## config/west.yml
```yaml
manifest:
  remotes:
    - name: zmkfirmware
      url-base: https://github.com/zmkfirmware
    - name: m165437
      url-base: https://github.com/M165437         # gem
    - name: gpeye
      url-base: https://github.com/GPeye           # slideshow
    - name: mctechnology17
      url-base: https://github.com/mctechnology17  # gem with dog
    - name: MrBanh
      url-base: https://github.com/MrBanh          # bongo cat
  projects:
    - name: zmk
      remote: zmkfirmware
      revision: v0.2
      import: app/west.yml
    - name: nice-view-gem
      remote: m165437
      revision: main
    - name: hammerbeam-slideshow
      remote: gpeye
      revision: main
    - name: zmk-nice-oled
      remote: mctechnology17
      revision: main  
    - name: nice-view-bongo-cat
      remote: MrBanh
      revision: main
  self:
    path: config
```
